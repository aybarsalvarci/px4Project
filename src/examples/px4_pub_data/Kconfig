## src/examples/px4_pub_data/Kconfig
```kconfig
menuconfig EXAMPLES_PX4_PUB_DATA
	bool "px4_pub_data"
	default n
	---help---
		Enable support for px4_pub_data
```

## src/examples/px4_say_hello/Kconfig
```kconfig
menuconfig EXAMPLES_PX4_SAY_HELLO
	bool "px4_say_hello"
	default n
	---help---
		Enable support for px4_say_hello
```

## src/examples/px4_sub_sensor/Kconfig
```kconfig
menuconfig EXAMPLES_PX4_SUB_SENSOR
	bool "px4_sub_sensor"
	default n
	---help---
		Enable support to px4_sub_sensor
```
